## applications/zephyr_modified_soc_thermometer/sample.yaml
```yaml
sample:
  description: This example implements the Health Thermometer service with the Silabs development Kit via Bluetooth on Zephyr OS.
  name: zephyr_modified_soc_thermometer

tests:
  sample.basic.zephyr_mikrobus_demo:
    tags: experimental
```

## applications/zephyr_ota_firmware_update/sample.yaml
```yaml
sample:
  description: The vision of this project is to provide developers with clear examples of OTA firmware updates over Bluetooth Low Energy (BLE) with the Zephyr OS on various Silicon Labs development kits.
  name: zephyr_ota_firmware_update

tests:
  sample.basic.zephyr_ota_firmware_update:
    tags: experimental
```

## applications/zephyr_si7210_onboard_led/sample.yaml
```yaml
sample:
  description: The example also demonstrate the utilization of the built-in Si7210 Hall Effect Magnetic sensor 
    and an onboard led with Zephyr OS.
  name: Zephyr - Si7210 Hall Effect Magnetic Sensor

tests:
  sample.basic.za_si7210_onboard_led:
    platform_allow : efr32bg22_brd4184b, efr32xg24_dk2601b, efr32bg27_brd2602a
    tags: experimental
```

## drivers/input/Kconfig
```kconfig
# Copyright (c) 2025 Silicon Laboratories Inc. www.silabs.com
# SPDX-License-Identifier: Apache-2.0

if INPUT
rsource "Kconfig.resistive_touch_4wire"
endif # INPUT
```

## drivers/sensor/bmp384/Kconfig
```kconfig
# Copyright (c) 2020 Facebook, Inc. and its affiliates
# SPDX-License-Identifier: Apache-2.0

menuconfig BMP384
	bool "Bosch BMP384 pressure sensor"
	default n
	depends on DT_HAS_BOSCH_BMP384_ENABLED
	select I2C if $(dt_compat_on_bus,$(DT_COMPAT_BOSCH_BMP384),i2c)
	select SPI if $(dt_compat_on_bus,$(DT_COMPAT_BOSCH_BMP384),spi)
	help
	  Enable driver for the Bosch BMP384 pressure sensor

if BMP384

choice BMP384_TRIGGER_MODE
	prompt "Trigger mode"
	default BMP384_TRIGGER_GLOBAL_THREAD
	help
	  Specify the type of triggering to be used by the driver.

config BMP384_TRIGGER_NONE
	bool "No trigger"

config BMP384_TRIGGER_GLOBAL_THREAD
	bool "Use global thread"
	select BMP384_TRIGGER

config BMP384_TRIGGER_OWN_THREAD
	bool "Use own thread"
	select BMP384_TRIGGER

config BMP384_TRIGGER_DIRECT
	bool "Use IRQ handler"
	select BMP384_TRIGGER
endchoice

config BMP384_TRIGGER
	bool

config BMP384_THREAD_PRIORITY
	int "Own thread priority"
	depends on BMP384_TRIGGER_OWN_THREAD
	default 10
	help
	  Priority of the thread used by the driver to handle interrupts.

config BMP384_THREAD_STACK_SIZE
	int "Own thread stack size"
	depends on BMP384_TRIGGER_OWN_THREAD
	default 1024
	help
	  Stack size of thread used by the driver to handle interrupts.

config BMP384_ODR_RUNTIME
	bool "Change ODR at runtime."
	default y

config BMP384_OSR_RUNTIME
	bool "Change OSR at runtime."
	default y

endif # BMP384
```

## dts/bindings/input/resistive-touchscreen-4wire.yaml
```yaml
# Copyright (c) 2025 Silicon Laboratories Inc. www.silabs.com
# SPDX-License-Identifier: Apache-2.0

description: |
  ADC based analog axis input device

  Implement an input device generating absolute axis events by periodically
  reading from some ADC channels.

  Example configuration:

  #include <zephyr/dt-bindings/input/input-event-codes.h>

  resistive_touch {
          compatible = "resistive-touch";
          poll-period-ms = <15>;
          axis-x {
                  io-channels = <&adc 0>;
                  out-deadzone = <8>;
                  in-min = <100>;
                  in-max = <800>;
                  zephyr,axis = <INPUT_ABS_X>;
          };
  };

compatible: "resistive-touchscreen-4wire"

include: base.yaml

properties:

  poll-period-ms:
    type: int
    default: 15
    description: |
      How often to get new ADC samples for the various configured axes in
      milliseconds. Defaults to 15ms if unspecified.

  h-res:
    type: int
    default: 320
    description: |
      Horizontal resolution.

  v-res:
    type: int
    default: 240
    description: |
      Vertical resolution.

  x-min:
      type: int
      required: true
      description: |
        Input value that corresponds to the minimum x value.

  x-max:
      type: int
      required: true
      description: |
        Input value that corresponds to the maximum x value.axmaximum

  y-min:
      type: int
      required: true
      description: |
        Input value that corresponds to the minimum y value.

  y-max:
      type: int
      required: true
      description: |
        Input value that corresponds to the maximum y value.

  xy-swap:
      type: boolean
      description: |
        Swap x-y coordinator

  r-xplate:
      type: int
      required: true
      description: |
        X plate resistance.

  r-touch-threshold:
      type: string
      required: true
      description: |
        Input value that corresponds to the resistance threshold of xy plate.

  xm-gpios:
      type: phandle-array
      required: true

  xp-gpios:
      type: phandle-array
      required: true

  ym-gpios:
      type: phandle-array
      required: true

  yp-gpios:
      type: phandle-array
      required: true


child-binding:
  properties:
    io-channels:
      type: phandle-array
      required: true
      description: |
        ADC IO channel to use.

    zephyr,wire:
      type: int
      required: true
      description: |
        The input wire of touch screen, typically any of
        INPUT_4WIRE_TS_*.
```

## dts/bindings/sensor/bosch,bmp384.yaml
```yaml
# Copyright (c) 2025 Silicon Laboratories Inc. www.silabs.com
# SPDX-License-Identifier: Apache-2.0

description: Pressure Sensor BMP384

compatible: "bosch,bmp384"

include: [sensor-device.yaml, i2c-device.yaml]
```

## dts/bindings/sensor/invensense,icm20689.yaml
```yaml
# Copyright (c) 2025 Silicon Laboratories Inc. www.silabs.com
# SPDX-License-Identifier: Apache-2.0

description: ICM-20689 6-Axis Inertial Sensor

compatible: "invensense,icm20689"

include: [sensor-device.yaml, spi-device.yaml]

properties:
  int-gpios:
    type: phandle-array
    description: |
      The INT signal default configuration is active-high. The
      property value should ensure the flags properly describe the
      signal that is presented to the driver.

  accel-bw:
    type: int
    required: true
    description: |
      Default bandwith of accelerometer. (Unit - Hz)
      Maps to ACCEL_ODR field in ACCEL_CONFIG0 setting
    enum:
      - 5
      - 10
      - 21
      - 44
      - 99
      - 218
      - 1046
      - 420


  gyro-bw:
    type: int
    required: true
    description: |
      Default bandwith of gyroscope. (Unit - Hz)
      Maps to GYRO_ODR field in GYRO_CONFIG0 setting
    enum:
      - 5
      - 10
      - 20
      - 41
      - 92
      - 176
      - 250
      - 3281
      - 8173

  accel-fs:
    type: int
    required: true
    description: |
      Default full scale of accelerometer. (Unit - g)
      Maps to ACCEL_FS_SEL field in ACCEL_CONFIG0 setting
      Power-on reset value is 16
    enum:
      - 16
      - 8
      - 4
      - 2

  gyro-fs:
    type: int
    required: true
    description: |
      Default full scale of gyroscope. (Unit - DPS)
      Maps to GYRO_FS_SEL field in GYRO_CONFIG0 setting
      Power-on reset value is 2000
    enum:
      - 2000
      - 1000
      - 500
      - 250
```

## west.yml
```yaml
# Copyright (c) 2025 Silicon Laboratories Inc. www.silabs.com
# SPDX-License-Identifier: Apache-2.0

manifest:
  self:
    west-commands: scripts/west-commands.yml

  remotes:
    - name: zephyrproject-rtos
      url-base: https://github.com/zephyrproject-rtos

  projects:
    - name: zephyr
      remote: zephyrproject-rtos
      revision: v4.0.0
      import:
        # By using name-allowlist we can clone only the modules that are
        # strictly needed by the application.
        name-allowlist:
          - cmsis      # required by the ARM port
          - hal_silabs
          - lvgl
          - mbedtls
          - tinycrypt
```
