## CMakeLists.txt
```
# SPDX-License-Identifier: Apache-2.0

cmake_minimum_required(VERSION 3.20.0)
find_package(Zephyr REQUIRED HINTS $ENV{ZEPHYR_BASE})
project(zephyr_soc_throughput_peripheral)

target_sources(app PRIVATE src/main.c)
target_sources(app PRIVATE src/app.c)
target_sources(app PRIVATE src/peripheral/throughput_peripheral.c)
target_sources(app PRIVATE src/central/throughput_central.c)
target_sources(app PRIVATE src/central/throughput_central_interface.c)
target_sources(app PRIVATE src/throughput_gattdb.c)
target_sources(app PRIVATE src/cli_command_table.c)
target_sources(app PRIVATE src/throughput_ui_log.c)
target_sources(app PRIVATE src/throughput_ui_common.c)
target_sources(app PRIVATE src/bt_event.c)

target_include_directories(app PRIVATE src)
target_include_directories(app PRIVATE src/central)
target_include_directories(app PRIVATE src/peripheral)
```

## Kconfig
```
mainmenu "Bluetooth: Throughput"

config THROUGHPUT_UI_LOG_ENABLE
   bool "Enable logging"
   default y
   help
     Enables UI logging.

config THROUGHPUT_UI_LOG_REFRESH_ALL
   bool "Print entire display"
   default y
   help
     Enables printing all rows (entire display) on update method. By disabling this, rows are printed on parameter update.

config THROUGHPUT_UI_LOG_BOX_ENABLE
   bool "Draw box"
   default y
   help
     Enables drawing a box around the display area.

source "Kconfig.zephyr"
```

## prj.conf
```kconfig
CONFIG_DEBUG_OPTIMIZATIONS=n

CONFIG_MAIN_THREAD_PRIORITY=15
CONFIG_EVENTS=y

CONFIG_BT=y
# CONFIG_BT_CTLR_ADVANCED_FEATURES=y
# CONFIG_BT_CTLR_CONN_RSSI=y
# CONFIG_BT_CTLR_TX_PWR_DYNAMIC_CONTROL=y
CONFIG_BT_PERIPHERAL=y
CONFIG_BT_CENTRAL=y
CONFIG_BT_GATT_CLIENT=y
CONFIG_BT_GATT_DYNAMIC_DB=n
CONFIG_BT_GATT_AUTO_DISCOVER_CCC=y
CONFIG_BT_L2CAP_TX_MTU=247
CONFIG_BT_BUF_ACL_RX_SIZE=251
CONFIG_BT_BUF_ACL_TX_SIZE=251
#CONFIG_BT_CTLR_DATA_LENGTH_MAX=247
CONFIG_BT_AUTO_PHY_UPDATE=n
CONFIG_BT_TRANSMIT_POWER_CONTROL=y
CONFIG_BT_USER_PHY_UPDATE=y
CONFIG_BT_USER_DATA_LEN_UPDATE=y
#CONFIG_BT_L2CAP_TX_BUF_COUNT=6
CONFIG_SHELL=y
CONFIG_GPIO=y
CONFIG_LOG=y
CONFIG_LOG_PROCESS_THREAD=y
CONFIG_LOG_BUFFER_SIZE=512
CONFIG_SYSTEM_WORKQUEUE_STACK_SIZE=8192
CONFIG_MAIN_STACK_SIZE=2752

CONFIG_THROUGHPUT_UI_LOG_ENABLE=y
```

## src/main.c
```c
/***************************************************************************//**
 * @file main.c
 * @brief zephyr si7210 hall effect magnetic sensor source file.
 *******************************************************************************
 * # License
 * <b>Copyright 2025 Silicon Laboratories Inc. www.silabs.com</b>
 *******************************************************************************
 *
 * SPDX-License-Identifier: Zlib
 *
 * The licensor of this software is Silicon Laboratories Inc.
 *
 * This software is provided \'as-is\', without any express or implied
 * warranty. In no event will the authors be held liable for any damages
 * arising from the use of this software.
 *
 * Permission is granted to anyone to use this software for any purpose,
 * including commercial applications, and to alter it and redistribute it
 * freely, subject to the following restrictions:
 *
 * 1. The origin of this software must not be misrepresented; you must not
 *    claim that you wrote the original software. If you use this software
 *    in a product, an acknowledgment in the product documentation would be
 *    appreciated but is not required.
 * 2. Altered source versions must be plainly marked as such, and must not be
 *    misrepresented as being the original software.
 * 3. This notice may not be removed or altered from any source distribution.
 *
 *******************************************************************************
 * # EXPERIMENTAL QUALITY
 * This code has not been formally tested and is provided as-is. It is not
 * suitable for production environments. In addition, this code will not be
 * maintained and there may be no bug maintenance planned for these resources.
 * Silicon Labs may update projects from time to time.
 ******************************************************************************/
#include <zephyr/kernel.h>
#include "app.h"

/***************************************************************************//**
 * Main thread function.
 ******************************************************************************/
int main()
{
  app_init();

  while (1) {
    app_process_action();
  }
  return 0;
}
```

## src/app.c
```c
/***************************************************************************//**
 * @file app.c
 * @brief zephyr application source file.
 *******************************************************************************
 * # License
 * <b>Copyright 2025 Silicon Laboratories Inc. www.silabs.com</b>
 *******************************************************************************
 *
 * SPDX-License-Identifier: Zlib
 *
 * The licensor of this software is Silicon Laboratories Inc.
 *
 * This software is provided \'as-is\', without any express or implied
 * warranty. In no event will the authors be held liable for any damages
 * arising from the use of this software.
 *
 * Permission is granted to anyone to use this software for any purpose,
 * including commercial applications, and to alter it and redistribute it
 * freely, subject to the following restrictions:
 *
 * 1. The origin of this software must not be misrepresented; you must not
 *    claim that you wrote the original software. If you use this software
 *    in a product, an acknowledgment in the product documentation would be
 *    appreciated but is not required.
 * 2. Altered source versions must be plainly marked as such, and must not be
 *    misrepresented as being the original software.
 * 3. This notice may not be removed or altered from any source distribution.
 *
 *******************************************************************************
 * # EXPERIMENTAL QUALITY
 * This code has not been formally tested and is provided as-is. It is not
 * suitable for production environments. In addition, this code will not be
 * maintained and there may be no bug maintenance planned for these resources.
 * Silicon Labs may update projects from time to time.
 ******************************************************************************/
#include <stddef.h>
#include <string.h>
#include <errno.h>

#include <zephyr/kernel.h>
#include <zephyr/types.h>
#include <zephyr/drivers/gpio.h>

#include <zephyr/logging/log.h>
#include <zephyr/shell/shell.h>
#include <zephyr/bluetooth/bluetooth.h>
#include <zephyr/bluetooth/gatt.h>

#include "throughput_types.h"
#include "throughput_peripheral.h"
#include "throughput_central.h"

LOG_MODULE_REGISTER(app, 3);

// -----------------------------------------------------------------------------
//                       Local Variables
// -----------------------------------------------------------------------------
static const struct gpio_dt_spec btn = GPIO_DT_SPEC_GET(DT_ALIAS(sw0), gpios);
static const struct gpio_dt_spec led = GPIO_DT_SPEC_GET(DT_ALIAS(led0), gpios);

static struct gpio_callback gpio_cb;

// Desired role for throughput
throughput_role_t global_desired_role;

/// Current role for throughput
throughput_role_t role;

/// Current button state for testing
uint8_t button_previous = 0;

/// Mask first button release
bool mask_release = false;

/// Current button state for testing
throughput_notification_t throughput_test_type = BT_GATT_CCC_NOTIFY;

/// Current state of buttons
volatile uint8_t button_current;

/// Change of buttons
uint8_t button_change = 0;

/// Timer for button press handling
struct k_timer button_timer;

/// Timer rised for short press
bool button_timer_rised = false;

#define K_EVENT_APP_TEST_ON  (1 << 0)
#define K_EVENT_APP_TEST_OFF (1 << 1)
K_EVENT_DEFINE(my_event);

// -----------------------------------------------------------------------------
//                       Static function declaration
// -----------------------------------------------------------------------------
void app_test(bool start);
static void bt_ready(int err);
static int button_init(gpio_callback_handler_t handler,
                       const struct gpio_dt_spec *button);
static int led_init(void);
static void button_callback(const struct device *gpiob,
                            struct gpio_callback *cb,
                            uint32_t pins);
void app_button_timer_callback(struct k_timer *timer);
void app_handle_button_press(void);
void app_set_test_type(throughput_notification_t test_type);

static void enable_new_throughput_role(throughput_role_t new_role);
static int set_role_request_and_disable_current_role(
  throughput_role_t role_request);
static void set_role(throughput_role_t new_role);
static void handle_cli_switch_command(throughput_role_t role_request);

/***************************************************************************//**
 * Application initialization function.
 ******************************************************************************/
void app_init(void)
{
  int err;

  err = button_init(button_callback, &btn);
  if (err) {
    LOG_ERR("Button init failed (err %d)", err);
  }
  k_timer_init(&button_timer, app_button_timer_callback, 0);

  err = led_init();
  if (err) {
    LOG_ERR("LED init failed (err %d)", err);
  }

  /* Initialize the Bluetooth Subsystem */
  err = bt_enable(bt_ready);
  if (err) {
    LOG_ERR("Bluetooth init failed (err %d)", err);
  }

  if (gpio_pin_get(btn.port, btn.pin)) {
    // Enable throughput test in Central mode if button is pressed
    LOG_INF("Button is pressed on start: Central mode set.");
    set_role(THROUGHPUT_ROLE_CENTRAL);

    throughput_central_enable();
    // Mask first button release
    mask_release = true;
  } else {
    // Enable throughput test in Peripheral mode
    LOG_INF("Peripheral mode set.");
    set_role(THROUGHPUT_ROLE_PERIPHERAL);

    throughput_peripheral_enable();
  }
}

/***************************************************************************//**
 * App ticking function.
 ******************************************************************************/
void app_process_action(void)
{
  // Mask first button release
  if (mask_release && button_change && !button_current) {
    button_change = 0;
    mask_release = false;
  }

  // Identify button change
  button_change = (button_current ^ button_previous);

  // There is a button change
  if (button_change) {
    // Handle button press during operation
    app_handle_button_press();
  }

  // Save current button states
  button_previous = button_current;

  // uint32_t events = k_event_wait(&my_event, 0xFFF, false, K_MSEC(5));
  uint32_t events = k_event_wait(&my_event, 0xFFF, false, K_NO_WAIT);
  if (events & K_EVENT_APP_TEST_ON) {
    k_event_clear(&my_event, K_EVENT_APP_TEST_ON);
    app_test(true);
  }

  if (events & K_EVENT_APP_TEST_OFF) {
    app_test(false);
  }

  throughput_peripheral_step();

  throughput_central_step();

  k_yield();
}

// -----------------------------------------------------------------------------
//                       Local Function Definition
// -----------------------------------------------------------------------------

/**************************************************************************//**
 * Start or stop the test
 * @param[in] start true if start is required
 *****************************************************************************/
void app_test(bool start)
{
  int err;
  if (start) {
    // Start test
    LOG_INF("[TEST MODE] %s",
            throughput_test_type
            == BT_GATT_CCC_NOTIFY ? "NOTIFICATION" : "INDICATION");
    LOG_INF("Starting test...");
    if (role == THROUGHPUT_ROLE_PERIPHERAL) {
      err = throughput_peripheral_start(throughput_test_type);
      if (err != 0) {
        LOG_WRN("Failed to start test.");
      }
    } else {
      err = throughput_central_set_type(throughput_test_type);
      if (err != 0) {
        LOG_WRN("Failed to set test type.");
      } else {
        err = throughput_central_start();
        if (err != 0) {
          LOG_WRN("Failed to start test.");
        }
      }
    }
  } else {
    // Stop
    LOG_INF("Stopping test...");
    if (role == THROUGHPUT_ROLE_PERIPHERAL) {
      err = throughput_peripheral_stop();
      if (err != 0) {
        LOG_WRN("Failed to stop test.");
      } else {
        LOG_INF("Test Stopped.");
      }
    } else {
      err = throughput_central_stop();
      if (err != 0) {
        LOG_WRN("Failed to stop test.");
      } else {
        LOG_INF("Test Stopped.");
      }
    }
  }
}

/**************************************************************************//**
 *  BLE initialization callback.
 ******************************************************************************/
static void bt_ready(int err)
{
  if (err) {
    LOG_ERR("Bluetooth initialized failed (err %d)", err);
    return;
  }
  LOG_INF("Bluetooth initialized successful");
}

/**************************************************************************//**
 *  Button initialization.
 ******************************************************************************/
static int button_init(gpio_callback_handler_t handler,
                       const struct gpio_dt_spec *button)
{
  int ret;

  if (!gpio_is_ready_dt(button)) {
    LOG_ERR("Error: button GPIO device %s is not ready",
            button->port->name);
    return -ENODEV;
  }

  ret = gpio_pin_configure_dt(button, GPIO_INPUT);
  if (ret != 0) {
    LOG_ERR("Error %d: can't configure button on GPIO %s pin %d",
            ret, button->port->name, button->pin);
    return ret;
  }

  gpio_init_callback(&gpio_cb, handler, BIT(button->pin));
  gpio_add_callback(button->port, &gpio_cb);
  ret = gpio_pin_interrupt_configure_dt(button, GPIO_INT_EDGE_BOTH);
  if (ret != 0) {
    LOG_ERR("Error %d: can't configure button interrupt on "
            "GPIO %s pin %d", ret, button->port->name, button->pin);
    return ret;
  }
  return 0;
}

/**************************************************************************//**
 *  LED initialization.
 ******************************************************************************/
static int led_init(void)
{
  int ret;

  if (!gpio_is_ready_dt(&led)) {
    LOG_ERR("Error: LED on GPIO %s pin %d is not ready",
            led.port->name, led.pin);
    return -ENODEV;
  }

  ret = gpio_pin_configure_dt(&led, GPIO_OUTPUT_INACTIVE);
  if (ret < 0) {
    LOG_ERR("Error %d: failed to configure GPIO %s pin %d",
            ret, led.port->name, led.pin);
  }
  return ret;
}

/**************************************************************************//**
 * Handle buttons during operation
 *****************************************************************************/
void app_handle_button_press()
{
  if (button_current) {
    button_timer_rised = false;
    k_timer_start(&button_timer, K_MSEC(1000), K_MSEC(0));
  } else {
    k_timer_stop(&button_timer);
    if (button_timer_rised) {
      app_test(false);
      // k_event_set(&my_event, K_EVENT_APP_TEST_OFF);
    } else {
      if (throughput_test_type == BT_GATT_CCC_NOTIFY) {
        throughput_test_type = BT_GATT_CCC_INDICATE;
      } else {
        throughput_test_type = BT_GATT_CCC_NOTIFY;
      }
      app_set_test_type(throughput_test_type);
    }
  }
}

/**************************************************************************//**
 *
 *****************************************************************************/
static void enable_new_throughput_role(throughput_role_t new_role)
{
  switch (new_role) {
    case THROUGHPUT_ROLE_CENTRAL:
      set_role(new_role);
      throughput_central_enable();
      break;

    case THROUGHPUT_ROLE_PERIPHERAL:
      set_role(new_role);
      throughput_peripheral_enable();
      break;
  }
}

static int set_role_request_and_disable_current_role(
  throughput_role_t role_request)
{
  int err = 0;

  // If state is not disconnected, we have to make sure, it will be disconnected
  switch (role) {
    case THROUGHPUT_ROLE_CENTRAL:
      err = throughput_central_disable();
      break;

    case THROUGHPUT_ROLE_PERIPHERAL:
      err = throughput_peripheral_disable();
      break;

    default:
      // Set the current role and desired role to the same role
      set_role(role);
      err = 1;
      break;
  }

  if (err == 0) {
    global_desired_role = role_request;
  }

  return err;
}

static void set_role(throughput_role_t new_role)
{
  role = new_role;
  // Make sure the global, desired role will change
  global_desired_role = role;
}

static void handle_cli_switch_command(throughput_role_t role_request)
{
  int err = 0;

  if (role != role_request) {
    err = set_role_request_and_disable_current_role(role_request);
  } else {
    LOG_WRN("Already in that state.");
  }

  if (err != 0) {
    LOG_WRN("There was an error during state change. STATUS: %d", err);
  }
}

/**************************************************************************//**
 * CLI command to switch from current state to central
 *****************************************************************************/
void cli_switch_to_central(const struct shell *sh, size_t argc, char **argv)
{
  ARG_UNUSED(sh);
  ARG_UNUSED(argc);
  ARG_UNUSED(argv);
  handle_cli_switch_command(THROUGHPUT_ROLE_CENTRAL);
}

/**************************************************************************//**
 * CLI command to switch from current state to peripheral
 *****************************************************************************/
void cli_switch_to_peripheral(const struct shell *sh, size_t argc, char **argv)
{
  ARG_UNUSED(sh);
  ARG_UNUSED(argc);
  ARG_UNUSED(argv);
  handle_cli_switch_command(THROUGHPUT_ROLE_PERIPHERAL);
}

/**************************************************************************//**
 * Timer callback
 *****************************************************************************/
void app_button_timer_callback(struct k_timer *timer)
{
  (void) timer;
  button_timer_rised = true;
  // app_test(true);
  k_event_set(&my_event, K_EVENT_APP_TEST_ON);
}

/**************************************************************************//**
 *  Button callback.
 ******************************************************************************/
static void button_callback(const struct device *gpiob,
                            struct gpio_callback *cb,
                            uint32_t pins)
{
  button_current = gpio_pin_get(btn.port, btn.pin);
}

/**************************************************************************//**
 * Set test type
 * @param[in] test_type type of the test:
 *  - sl_bt_gatt_notification or
 *  - sl_bt_gatt_indication
 *****************************************************************************/
void app_set_test_type(throughput_notification_t test_type)
{
  throughput_test_type = test_type;

  if (throughput_test_type == BT_GATT_CCC_INDICATE) {
    gpio_pin_set(led.port, led.pin, 1);
  } else {
    gpio_pin_set(led.port, led.pin, 0);
  }
}

/**************************************************************************//**
 * Callback to handle state change.
 * @param[in] state current state
 *****************************************************************************/
void throughput_central_on_state_change(throughput_state_t state)
{
  if (state == THROUGHPUT_STATE_UNINITALIZED) {
    enable_new_throughput_role(THROUGHPUT_ROLE_PERIPHERAL);
  }
}

/**************************************************************************//**
 * Callback to handle state change.
 * @param[in] state current state
 *****************************************************************************/
void throughput_peripheral_on_state_change(throughput_state_t state)
{
  if (state == THROUGHPUT_STATE_UNINITALIZED) {
    enable_new_throughput_role(THROUGHPUT_ROLE_CENTRAL);
  }
}
```

## src/app.h
```c
/***************************************************************************//**
 * @file app.h
 * @brief zephyr application header file.
 *******************************************************************************
 * # License
 * <b>Copyright 2025 Silicon Laboratories Inc. www.silabs.com</b>
 *******************************************************************************
 *
 * SPDX-License-Identifier: Zlib
 *
 * The licensor of this software is Silicon Laboratories Inc.
 *
 * This software is provided \'as-is\', without any express or implied
 * warranty. In no event will the authors be held liable for any damages
 * arising from the use of this software.
 *
 * Permission is granted to anyone to use this software for any purpose,
 * including commercial applications, and to alter it and redistribute it
 * freely, subject to the following restrictions:
 *
 * 1. The origin of this software must not be misrepresented; you must not
 *    claim that you wrote the original software. If you use this software
 *    in a product, an acknowledgment in the product documentation would be
 *    appreciated but is not required.
 * 2. Altered source versions must be plainly marked as such, and must not be
 *    misrepresented as being the original software.
 * 3. This notice may not be removed or altered from any source distribution.
 *
 *******************************************************************************
 * # EXPERIMENTAL QUALITY
 * This code has not been formally tested and is provided as-is. It is not
 * suitable for production environments. In addition, this code will not be
 * maintained and there may be no bug maintenance planned for these resources.
 * Silicon Labs may update projects from time to time.
 ******************************************************************************/

#ifndef APP_H_
#define APP_H_

/***************************************************************************//**
 * Initialize application.
 ******************************************************************************/
void app_init(void);

/***************************************************************************//**
 * App ticking function.
 ******************************************************************************/
void app_process_action(void);

#endif /*APP_H_*/
```

## src/bt_event.c
```c
/***************************************************************************//**
 * @file bt_event.c
 * @brief
 *******************************************************************************
 * # License
 * <b>Copyright 2025 Silicon Laboratories Inc. www.silabs.com</b>
 *******************************************************************************
 *
 * SPDX-License-Identifier: Zlib
 *
 * The licensor of this software is Silicon Laboratories Inc.
 *
 * This software is provided \'as-is\', without any express or implied
 * warranty. In no event will the authors be held liable for any damages
 * arising from the use of this software.
 *
 * Permission is granted to anyone to use this software for any purpose,
 * including commercial applications, and to alter it and redistribute it
 * freely, subject to the following restrictions:
 *
 * 1. The origin of this software must not be misrepresented; you must not
 *    claim that you wrote the original software. If you use this software
 *    in a product, an acknowledgment in the product documentation would be
 *    appreciated but is not required.
 * 2. Altered source versions must be plainly marked as such, and must not be
 *    misrepresented as being the original software.
 * 3. This notice may not be removed or altered from any source distribution.
 *
 *******************************************************************************
 * # EXPERIMENTAL QUALITY
 * This code has not been formally tested and is provided as-is. It is not
 * suitable for production environments. In addition, this code will not be
 * maintained and there may be no bug maintenance planned for these resources.
 * Silicon Labs may update projects from time to time.
 ******************************************************************************/
#include <stdio.h>
#include <zephyr/logging/log.h>

#include "bt_event.h"

LOG_MODULE_REGISTER(bt_event, 3);

K_MSGQ_DEFINE(bt_evt_msgq, sizeof(struct bt_evt), 10, 1);

static bool conn_callbacks_registered = false;

static struct bt_gatt_discover_params discover_params;

/*******************************************************************************
 **************************   LOCAL FUNCTIONS   ********************************
 ******************************************************************************/
static const char *uuid_to_str(const struct bt_uuid *uuid)
{
  static char uuid_str[40];

  bt_uuid_to_str(uuid, uuid_str, sizeof(uuid_str));
  return uuid_str;
}

/**************************************************************************//**
 *  BLE connected callback.
 ******************************************************************************/
static void connected(struct bt_conn *connected, uint8_t err)
{
  struct bt_evt bt_evt;

  bt_evt.id = bt_evt_connection_opened_id;
  bt_evt.data.connection_opened.conn = connected;
  bt_evt.data.connection_opened.err = err;

  k_msgq_put(&bt_evt_msgq, &bt_evt, K_FOREVER);
}

/**************************************************************************//**
 *  BLE disconnected callback.
 ******************************************************************************/
static void disconnected(struct bt_conn *disconn, uint8_t reason)
{
  struct bt_evt bt_evt;

  bt_evt.id = bt_evt_connection_closed_id;
  bt_evt.data.connection_closed.conn = disconn;
  bt_evt.data.connection_closed.reason = reason;

  k_msgq_put(&bt_evt_msgq, &bt_evt, K_FOREVER);
}

static bool le_param_req(struct bt_conn *conn,
                         struct bt_le_conn_param *param)
{
  LOG_INF("le_param_req");
  return true;
}

static void param_updated(struct bt_conn *conn, uint16_t interval,
                          uint16_t latency, uint16_t timeout)
{
  struct bt_evt bt_evt;

  bt_evt.id = bt_evt_le_param_updated_id;
  bt_evt.data.le_param_updated.conn = conn;
  bt_evt.data.le_param_updated.interval = interval;
  bt_evt.data.le_param_updated.latency = latency;
  bt_evt.data.le_param_updated.timeout = timeout;

  k_msgq_put(&bt_evt_msgq, &bt_evt, K_FOREVER);
}

static void le_phy_updated(struct bt_conn *conn,
                           struct bt_conn_le_phy_info *param)
{
  struct bt_evt bt_evt;

  bt_evt.id = bt_evt_le_phy_updated_id;
  bt_evt.data.le_phy_updated.conn = conn;
  bt_evt.data.le_phy_updated.tx_phy = param->tx_phy;
  bt_evt.data.le_phy_updated.rx_phy = param->rx_phy;

  k_msgq_put(&bt_evt_msgq, &bt_evt, K_FOREVER);
}

static void le_data_len_updated(struct bt_conn *conn,
                                struct bt_conn_le_data_len_info *info)
{
  struct bt_evt bt_evt;

  bt_evt.id = bt_evt_le_data_len_updated_id;
  bt_evt.data.le_data_len_updated.conn = conn;
  bt_evt.data.le_data_len_updated.tx_max_len = info->tx_max_len;
  bt_evt.data.le_data_len_updated.tx_max_time = info->tx_max_time;
  bt_evt.data.le_data_len_updated.tx_max_time = info->rx_max_len;
  bt_evt.data.le_data_len_updated.tx_max_time = info->rx_max_time;

  k_msgq_put(&bt_evt_msgq, &bt_evt, K_FOREVER);
}

static void tx_power_report(struct bt_conn *conn,
                            const struct bt_conn_le_tx_power_report *report)
{
  struct bt_evt bt_evt;

  bt_evt.id = bt_evt_tx_power_report_id;
  bt_evt.data.tx_power_report.conn = conn;
  bt_evt.data.tx_power_report.conn = conn;
  bt_evt.data.tx_power_report.reason = report->reason;
  bt_evt.data.tx_power_report.phy = report->phy;
  bt_evt.data.tx_power_report.tx_power_level = report->tx_power_level;
  bt_evt.data.tx_power_report.tx_power_level_flag = report->tx_power_level_flag;
  bt_evt.data.tx_power_report.delta = report->delta;

  k_msgq_put(&bt_evt_msgq, &bt_evt, K_FOREVER);
}

static struct bt_conn_cb conn_callbacks = {
  .connected = connected,
  .disconnected = disconnected,
  .le_param_req = le_param_req,
  .le_param_updated = param_updated,
  .le_phy_updated = le_phy_updated,
  .le_data_len_updated = le_data_len_updated,
  .tx_power_report = tx_power_report,
};

static void mtu_exchange_callback(struct bt_conn *conn, uint8_t err,
                                  struct bt_gatt_exchange_params *params)
{
  struct bt_evt bt_evt;

  bt_evt.id = bt_evt_exchange_mtu_id;
  bt_evt.data.exchange_mtu.conn = conn;
  bt_evt.data.exchange_mtu.err = err;

  k_msgq_put(&bt_evt_msgq, &bt_evt, K_FOREVER);
}

int bt_evt_exchange_mtu(struct bt_conn *conn,
                        struct bt_gatt_exchange_params *params)
{
  // Start mtu exchange
  params->func = mtu_exchange_callback;

  return bt_gatt_exchange_mtu(conn, params);
}

static uint8_t discover_callback(struct bt_conn *conn,
                                 const struct bt_gatt_attr *attr,
                                 struct bt_gatt_discover_params *params)
{
  struct bt_evt bt_evt;
  uint8_t uuid_size;

  if (!attr) {
    LOG_INF("Discover complete");
    (void)memset(params, 0, sizeof(*params));
    return BT_GATT_ITER_STOP;
  }

  LOG_INF("attr uuid:   %s", uuid_to_str(attr->uuid));
  LOG_INF("params uuid: %s", uuid_to_str(params->uuid));

  bt_evt.id = bt_evt_gatt_discover_attrs_id;
  bt_evt.data.gatt_discover_attrs.conn = conn;
  if (params->uuid->type == BT_UUID_TYPE_16) {
    uuid_size = sizeof(struct bt_uuid_16);
  } else if (params->uuid->type == BT_UUID_TYPE_32) {
    uuid_size = sizeof(struct bt_uuid_32);
  } else {
    uuid_size = sizeof(struct bt_uuid_128);
  }
  memcpy(&(bt_evt.data.gatt_discover_attrs.uuid),
         params->uuid,
         uuid_size);
  bt_evt.data.gatt_discover_attrs.handle = attr->handle;
  bt_evt.data.gatt_discover_attrs.perm = attr->perm;
  bt_evt.data.gatt_discover_attrs.value_handle =
    bt_gatt_attr_value_handle(attr);

  k_msgq_put(&bt_evt_msgq, &bt_evt, K_FOREVER);

  return BT_GATT_ITER_STOP;
}

void le_scan_cb(const bt_addr_le_t *addr, int8_t rssi,
                uint8_t adv_type, struct net_buf_simple *buf)
{
  struct bt_evt bt_evt;

  bt_evt.id = bt_evt_le_scan_report_id;
  memcpy(&(bt_evt.data.le_scan_report.addr),
         addr,
         sizeof(bt_addr_le_t));
  bt_evt.data.le_scan_report.rssi = rssi;
  bt_evt.data.le_scan_report.type = adv_type;
  uint16_t len = ADV_DATA_MAX_LENGTH;
  if (len > buf->len) {
    len = buf->len;
  }
  memcpy(bt_evt.data.le_scan_report.buf.data, buf->data, len);

  k_msgq_put(&bt_evt_msgq, &bt_evt, K_FOREVER);
}

int bt_evt_le_scan_start(const struct bt_le_scan_param *param)
{
  return bt_le_scan_start(param, le_scan_cb);
}

int bt_evt_discover_attr(struct bt_conn *conn,
                         uint8_t type,
                         const struct bt_uuid *uuid,
                         uint16_t start_handle,
                         uint16_t end_handle)
{
  discover_params.type = type;
  discover_params.uuid = uuid;
  discover_params.func = discover_callback;
  discover_params.start_handle = start_handle;
  discover_params.end_handle = end_handle;
  LOG_INF("Start discover");
  return bt_gatt_discover(conn, &discover_params);
}

static uint8_t notification_callback(struct bt_conn *conn,
                                     struct bt_gatt_subscribe_params *params,
                                     const void *data, uint16_t length)
{
  struct bt_evt bt_evt;

  if (!data) {
    LOG_INF("[UNSUBSCRIBED]\n");
    params->value_handle = 0U;
    return BT_GATT_ITER_STOP;
  }

  bt_evt.id = bt_evt_gatt_characteristic_notification_id;
  bt_evt.data.gatt_characteristic_notification.conn = conn;
  bt_evt.data.gatt_characteristic_notification.value_handle =
    params->value_handle;
  if (length > ATTR_DATA_MAX_LENGTH) {
    length = ATTR_DATA_MAX_LENGTH;
  }
  memcpy(bt_evt.data.gatt_characteristic_notification.value.data,
         data,
         length);
  bt_evt.data.gatt_characteristic_notification.value.len = length;

  k_msgq_put(&bt_evt_msgq, &bt_evt, K_FOREVER);

  return BT_GATT_ITER_CONTINUE;
}

static void subscribe_status(struct bt_conn *conn, uint8_t err,
                             struct bt_gatt_subscribe_params *params)
{
  struct bt_evt bt_evt;

  bt_evt.id = bt_evt_gatt_characteristic_subscribe_status_id;
  bt_evt.data.gatt_characteristic_subscribe_status.conn = conn;
  bt_evt.data.gatt_characteristic_subscribe_status.err = err;
  bt_evt.data.gatt_characteristic_subscribe_status.params = params;

  k_msgq_put(&bt_evt_msgq, &bt_evt, K_FOREVER);
  LOG_INF("[SUBSCRIBE] status: %d, value_handle = %d", err,
          params->value_handle);
}

#if defined(CONFIG_BT_GATT_AUTO_DISCOVER_CCC)
int bt_evt_gatt_subscribe_for_notification(struct bt_conn *conn,
                                           struct bt_gatt_subscribe_params *params,
                                           struct bt_gatt_discover_params *disc_params)
{
  params->ccc_handle = 0;
  params->end_handle = BT_ATT_LAST_ATTRIBUTE_HANDLE;
  params->value = BT_GATT_CCC_NOTIFY;
  params->notify = notification_callback;
  params->subscribe = subscribe_status;
  params->disc_params = disc_params;
  return bt_gatt_subscribe(conn, params);
}

#else
int bt_evt_gatt_subscribe_for_notification(struct bt_conn *conn,
                                           struct bt_gatt_subscribe_params *params)
{
  params->ccc_handle = 0;
  params->end_handle = BT_ATT_LAST_ATTRIBUTE_HANDLE;
  params->value = BT_GATT_CCC_NOTIFY;
  params->notify = notification_callback;
  params->subscribe = subscribe_status;
  return bt_gatt_subscribe(conn, params);
}

#endif

static uint8_t indication_callback(struct bt_conn *conn,
                                   struct bt_gatt_subscribe_params *params,
                                   const void *data, uint16_t length)
{
  struct bt_evt bt_evt;

  if (!data) {
    LOG_INF("[UNSUBSCRIBED]\n");
    params->value_handle = 0U;
    return BT_GATT_ITER_STOP;
  }

  bt_evt.id = bt_evt_gatt_characteristic_indication_id;
  bt_evt.data.gatt_characteristic_indication.conn = conn;
  bt_evt.data.gatt_characteristic_indication.value_handle =
    params->value_handle;
  if (length > ATTR_DATA_MAX_LENGTH) {
    length = ATTR_DATA_MAX_LENGTH;
  }
  memcpy(bt_evt.data.gatt_characteristic_indication.value.data,
         data,
         length);
  bt_evt.data.gatt_characteristic_indication.value.len = length;

  k_msgq_put(&bt_evt_msgq, &bt_evt, K_FOREVER);

  return BT_GATT_ITER_CONTINUE;
}

#if defined(CONFIG_BT_GATT_AUTO_DISCOVER_CCC)
int bt_evt_gatt_subscribe_for_indication(struct bt_conn *conn,
                                         struct bt_gatt_subscribe_params *params,
                                         struct bt_gatt_discover_params *disc_params)
{
  params->ccc_handle = 0;
  params->end_handle = BT_ATT_LAST_ATTRIBUTE_HANDLE;
  params->value = BT_GATT_CCC_INDICATE;
  params->notify = indication_callback;
  params->subscribe = subscribe_status;
  params->disc_params = disc_params;
  return bt_gatt_subscribe(conn, params);
}

#else
int bt_evt_gatt_subscribe_for_indication(struct bt_conn *conn,
                                         struct bt_gatt_subscribe_params *params)
{
  params->ccc_handle = 0;
  params->end_handle = BT_ATT_LAST_ATTRIBUTE_HANDLE;
  params->value = BT_GATT_CCC_INDICATE;
  params->notify = indication_callback;
  params->subscribe = subscribe_status;
  return bt_gatt_subscribe(conn, params);
}

#endif

int bt_evt_wait_event(struct bt_evt *evt, k_timeout_t timeout)
{
  return k_msgq_get(&bt_evt_msgq, evt, timeout);
}

int bt_evt_external_signal(uint32_t signals)
{
  struct bt_evt bt_evt;

  bt_evt.id = bt_evt_system_external_signal_id;
  bt_evt.data.system_external_signal.extsignals = signals;
  return k_msgq_put(&bt_evt_msgq, &bt_evt, K_FOREVER);
}

void bt_evt_init(void)
{
  if (!conn_callbacks_registered) {
    bt_conn_cb_register(&conn_callbacks);
    conn_callbacks_registered = true;
  }
}
```

## src/bt_event.h
```c
/***************************************************************************//**
 * @file bt_event.h
 * @brief
 *******************************************************************************
 * # License
 * <b>Copyright 2025 Silicon Laboratories Inc. www.silabs.com</b>
 *******************************************************************************
 *
 * SPDX-License-Identifier: Zlib
 *
 * The licensor of this software is Silicon Laboratories Inc.
 *
 * This software is provided \'as-is\', without any express or implied
 * warranty. In no event will the authors be held liable for any damages
 * arising from the use of this software.
 *
 * Permission is granted to anyone to use this software for any purpose,
 * including commercial applications, and to alter it and redistribute it
 * freely, subject to the following restrictions:
 *
 * 1. The origin of this software must not be misrepresented; you must not
 *    claim that you wrote the original software. If you use this software
 *    in a product, an acknowledgment in the product documentation would be
 *    appreciated but is not required.
 * 2. Altered source versions must be plainly marked as such, and must not be
 *    misrepresented as being the original software.
 * 3. This notice may not be removed or altered from any source distribution.
 *
 *******************************************************************************
 * # EXPERIMENTAL QUALITY
 * This code has not been formally tested and is provided as-is. It is not
 * suitable for production environments. In addition, this code will not be
 * maintained and there may be no bug maintenance planned for these resources.
 * Silicon Labs may update projects from time to time.
 ******************************************************************************/
#ifndef BT_EVENT_H_
#define BT_EVENT_H_

#include <zephyr/bluetooth/bluetooth.h>
#include <zephyr/bluetooth/conn.h>
#include <zephyr/bluetooth/uuid.h>
#include <zephyr/bluetooth/gatt.h>
#include <zephyr/bluetooth/gap.h>

#define ADV_DATA_MAX_LENGTH 255
typedef struct {
  bt_addr_le_t addr;
  int8_t rssi;
  uint8_t type;
  struct {
    uint16_t len;
    uint8_t data[ADV_DATA_MAX_LENGTH];
  } buf;
} bt_evt_le_scan_report_t;

#define ATTR_DATA_MAX_LENGTH 255
enum bt_evt_event_id {
  bt_evt_connection_opened_id,
  bt_evt_connection_closed_id,
  bt_evt_le_param_updated_id,
  bt_evt_le_phy_updated_id,
  bt_evt_le_data_len_updated_id,
  bt_evt_le_scan_report_id,
  bt_evt_tx_power_report_id,
  bt_evt_exchange_mtu_id,
  bt_evt_gatt_discover_attrs_id,
  bt_evt_gatt_characteristic_subscribe_status_id,
  bt_evt_gatt_characteristic_notification_id,
  bt_evt_gatt_characteristic_indication_id,
  bt_evt_system_external_signal_id
};

struct bt_evt {
  enum bt_evt_event_id id;
  union {
    struct {
      struct bt_conn *conn;
      uint8_t err;
    } connection_opened;

    struct {
      struct bt_conn *conn;
      uint8_t reason;
    } connection_closed;

    struct {
      struct bt_conn *conn;
      uint16_t interval;
      uint16_t latency;
      uint16_t timeout;
    } le_param_updated;

    struct {
      struct bt_conn *conn;
      uint16_t tx_max_len;
      uint16_t tx_max_time;
      uint16_t rx_max_len;
      uint16_t rx_max_time;
    } le_data_len_updated;

    bt_evt_le_scan_report_t le_scan_report;

    struct {
      struct bt_conn *conn;
      uint8_t reason;
      enum bt_conn_le_tx_power_phy phy;
      int8_t tx_power_level;
      uint8_t tx_power_level_flag;
      int8_t delta;
    } tx_power_report;

    struct {
      struct bt_conn *conn;
      uint8_t err;
    } exchange_mtu;

    struct {
      struct bt_conn *conn;
      uint8_t tx_phy;
      uint8_t rx_phy;
    } le_phy_updated;

    struct {
      struct bt_conn *conn;
      uint16_t handle;
      uint16_t perm;
      uint16_t value_handle;
      union {
        struct bt_uuid uuid;
        struct bt_uuid_16 uuid16;
        struct bt_uuid_32 uuid32;
        struct bt_uuid_128 uuid128;
      };
    } gatt_discover_attrs;

    struct {
      struct bt_conn *conn;
      uint8_t err;
      struct bt_gatt_subscribe_params *params;
    } gatt_characteristic_subscribe_status;

    struct {
      struct bt_conn *conn;
      uint16_t value_handle;
      struct {
        uint8_t len;
        uint8_t data[ATTR_DATA_MAX_LENGTH];
      } value;
    } gatt_characteristic_notification;

    struct {
      struct bt_conn *conn;
      uint16_t value_handle;
      struct {
        uint8_t len;
        uint8_t data[ATTR_DATA_MAX_LENGTH];
      } value;
    } gatt_characteristic_indication;

    struct {
      uint32_t extsignals;
    } system_external_signal;
  } data;
};

int bt_evt_le_scan_start(const struct bt_le_scan_param *param);

int bt_evt_exchange_mtu(struct bt_conn *conn,
                        struct bt_gatt_exchange_params *params);

int bt_evt_discover_attr(struct bt_conn *conn,
                         uint8_t type,
                         const struct bt_uuid *uuid,
                         uint16_t start_handle,
                         uint16_t end_handle);

#if defined(CONFIG_BT_GATT_AUTO_DISCOVER_CCC)
int bt_evt_gatt_subscribe_for_notification(struct bt_conn *conn,
                                           struct bt_gatt_subscribe_params *params,
                                           struct bt_gatt_discover_params *disc_params);

#else
int bt_evt_gatt_subscribe_for_notification(struct bt_conn *conn,
                                           struct bt_gatt_subscribe_params *params);

#endif

#if defined(CONFIG_BT_GATT_AUTO_DISCOVER_CCC)
int bt_evt_gatt_subscribe_for_indication(struct bt_conn *conn,
                                         struct bt_gatt_subscribe_params *params,
                                         struct bt_gatt_discover_params *disc_params);

#else
int bt_evt_gatt_subscribe_for_indication(struct bt_conn *conn,
                                         struct bt_gatt_subscribe_params *params);

#endif

int bt_evt_wait_event(struct bt_evt *evt, k_timeout_t timeout);

int bt_evt_external_signal(uint32_t signals);

void bt_evt_init(void);

#endif // BT_EVENT_H_
```

## src/throughput_common.h
```c
/***************************************************************************//**
 * @file throughput_common.h
 * @brief Throughput common definitions.
 *******************************************************************************
 * # License
 * <b>Copyright 2025 Silicon Laboratories Inc. www.silabs.com</b>
 *******************************************************************************
 *
 * SPDX-License-Identifier: Zlib
 *
 * The licensor of this software is Silicon Laboratories Inc.
 *
 * This software is provided \'as-is\', without any express or implied
 * warranty. In no event will the authors be held liable for any damages
 * arising from the use of this software.
 *
 * Permission is granted to anyone to use this software for any purpose,
 * including commercial applications, and to alter it and redistribute it
 * freely, subject to the following restrictions:
 *
 * 1. The origin of this software must not be misrepresented; you must not
 *    claim that you wrote the original software. If you use this software
 *    in a product, an acknowledgment in the product documentation would be
 *    appreciated but is not required.
 * 2. Altered source versions must be plainly marked as such, and must not be
 *    misrepresented as being the original software.
 * 3. This notice may not be removed or altered from any source distribution.
 *
 *******************************************************************************
 * # EXPERIMENTAL QUALITY
 * This code has not been formally tested and is provided as-is. It is not
 * suitable for production environments. In addition, this code will not be
 * maintained and there may be no bug maintenance planned for these resources.
 * Silicon Labs may update projects from time to time.
 ******************************************************************************/
#ifndef THROUGHPUT_COMMON_H
#define THROUGHPUT_COMMON_H

/***********************************************************************************************//**
 * @addtogroup throughput
 * @{
 **************************************************************************************************/

/// Discovering services/characteristics and subscribing raises
///   procedure_complete events
/// Actions are used to indicate which procedure was completed.
typedef enum {
  act_none = 0,
  act_discover_service,
  act_discover_characteristics,
  act_enable_transmission_notification,
  act_enable_notification,
  act_enable_indication,
  act_subscribe_result
} action_t;

/** @} (end addtogroup throughput) */
#endif // THROUGHPUT_COMMON_H
```

## src/throughput_gattdb.h
```c
/***************************************************************************//**
 * @file throughput_gattdb.h
 * @brief
 *******************************************************************************
 * # License
 * <b>Copyright 2025 Silicon Laboratories Inc. www.silabs.com</b>
 *******************************************************************************
 *
 * SPDX-License-Identifier: Zlib
 *
 * The licensor of this software is Silicon Laboratories Inc.
 *
 * This software is provided \'as-is\', without any express or implied
 * warranty. In no event will the authors be held liable for any damages
 * arising from the use of this software.
 *
 * Permission is granted to anyone to use this software for any purpose,
 * including commercial applications, and to alter it and redistribute it
 * freely, subject to the following restrictions:
 *
 * 1. The origin of this software must not be misrepresented; you must not
 *    claim that you wrote the original software. If you use this software
 *    in a product, an acknowledgment in the product documentation would be
 *    appreciated but is not required.
 * 2. Altered source versions must be plainly marked as such, and must not be
 *    misrepresented as being the original software.
 * 3. This notice may not be removed or altered from any source distribution.
 *
 *******************************************************************************
 * # EXPERIMENTAL QUALITY
 * This code has not been formally tested and is provided as-is. It is not
 * suitable for production environments. In addition, this code will not be
 * maintained and there may be no bug maintenance planned for these resources.
 * Silicon Labs may update projects from time to time.
 ******************************************************************************/
#ifndef THROUGHPUT_GATTDB_H
#define THROUGHPUT_GATTDB_H

#include <zephyr/bluetooth/gatt.h>

enum throughput_gattdb_char {
  throughput_gattdb_char_indication,
  throughput_gattdb_char_notification,
  throughput_gattdb_char_transmission_on,
  throughput_gattdb_char_throughput_result,
  throughput_gattdb_char_connection_phy,
  throughput_gattdb_char_connection_interval,
  throughput_gattdb_char_responder_latency,
  throughput_gattdb_char_supervision_timeout,
  throughput_gattdb_char_pdu_size,
  throughput_gattdb_char_mtu_size
};

/* Throughput Test Service */
extern struct bt_uuid_128 throughput_test_service_uuid;

// /* Throughput Information Service */
extern struct bt_uuid_128 throughput_information_service_uuid;

/* Indications characteristic */
extern const struct bt_uuid_128 indication_char_uuid;

/* Notifications characteristic */
extern const struct bt_uuid_128 notification_char_uuid;

/* Transmission ON characteristic */
extern const struct bt_uuid_128 transmission_on_char_uuid;

/* Throughput result characteristic */
extern const struct bt_uuid_128 throughput_result_char_uuid;

/* Connection PHY characteristic */
extern const struct bt_uuid_128 connection_phy_char_uuid;

/* Connection interval characteristic */
extern const struct bt_uuid_128 connection_interval_char_uuid;

/* Responder latency characteristic */
extern const struct bt_uuid_128 responder_latency_char_uuid;

/* Supervision timeout characteristic */
extern const struct bt_uuid_128 supervision_timeout_char_uuid;

/* PDU size characteristic */
extern const struct bt_uuid_128 pdu_size_char_uuid;

/* MTU size characteristic */
extern const struct bt_uuid_128 mtu_size_char_uuid;

extern const struct bt_gatt_service_static throughput_test_svc;
extern const struct bt_gatt_service_static throughput_information_svc;

void throughput_gattdb_register_char_read_cb(ssize_t (*cb)(
                                               enum throughput_gattdb_char c,
                                               struct bt_conn *conn,
                                               const struct bt_gatt_attr *attr,
                                               void *buf,
                                               uint16_t len,
                                               uint16_t offset));

void throughput_gattdb_register_char_write_cb(ssize_t (*cb)(
                                                enum throughput_gattdb_char c,
                                                struct bt_conn *conn,
                                                const struct bt_gatt_attr *attr,
                                                const void *buf,
                                                uint16_t len,
                                                uint16_t offset,
                                                uint8_t flags));

void throughput_gattdb_register_ccc_changed_cb(void (*cb)(
                                                 enum throughput_gattdb_char c,
                                                 const struct bt_gatt_attr *attr,
                                                 uint16_t value));

#endif // THROUGHPUT_GATTDB_H
```
